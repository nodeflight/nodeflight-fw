/* CPU: STM32F722xE */

MEMORY
{
RAM (xrw)         : ORIGIN = 0x20000000, LENGTH = 256K
FLASH_APP (rx)    : ORIGIN = 0x08000000, LENGTH = 512K - 128K
FLASH_L1CONF (rx) : ORIGIN = 0x08060000, LENGTH = 128K
}

INCLUDE "STM32.ld"